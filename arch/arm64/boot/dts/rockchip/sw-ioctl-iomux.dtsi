#include <dt-bindings/gpio/gpio.h>
#include <dt-bindings/pinctrl/rockchip.h>

/ {
	/* ========== seewo-ioctl 自定义设备 ========== */
	seewo_ioctl: seewo-ioctl {
		status = "okay";
		compatible = "seewo-ioctl";

		seewoctl-labels =
			"G1A0_D_MCU_BOOT",
			"G1D0_D_MCU_RST",
			"G1A4_D_MCU_UP_SW",
			"G2B5_U_AU_PWREN",
			"G2C4_D_DSP_GPIO_S0",
			"G2C1_D_DSP_GPIO_S1",
			"G2C2_D_DSP_GPIO_S2",
			"G2B0_U_WIFI_PWREN",
			"G2B4_U_WIFI_RST",
			"G1D2_D_5G_PWREN",
			"G1D3_D_5G_RST",
			"G4C5_D_PSE_PWREN",
			"G2B1_U_AP_PWREN",
			"G1D5_D_TP_PWREN",
			"G1C4_D_TP_RST",
			"G4D0_U_HUB20_RST",
			"G1D1_D_USB30_PWREN_B",
			"G4D2_U_USB20_PWREN_A",
			"G4D3_U_USB30_PWREN_A",
			"G1B3_D_HUB30_RST",
			"G4B5_D_HDMITX0_ON_IC",
			"G4B6_D_HDMITX1_ON_IC",
			"G4D1_U_PWREN_IC",
			"G4C3_D_LED_B",
			"G2C0_D_LED_R";

		/*
		 * 三元组: <&gpioX 引脚号 flags>
		 * 引脚号 = RK_P* 宏 (RK_PA0=0, RK_PD0=24, …)
		 */
		seewoctl-gpios = <&gpio1 RK_PA0 (GPIO_ACTIVE_LOW | GPIO_PULL_UP)>,
				 <&gpio1 RK_PD0 (GPIO_ACTIVE_LOW | GPIO_PULL_UP)>,
				 <&gpio1 RK_PA4 (GPIO_ACTIVE_LOW | GPIO_PULL_UP | GPIO_OPEN_DRAIN)>,
				 <&gpio2 RK_PB5 (GPIO_ACTIVE_LOW | GPIO_PULL_UP | GPIO_OPEN_DRAIN)>,
				 <&gpio2 RK_PC4 (GPIO_ACTIVE_LOW | GPIO_PULL_UP)>,
				 <&gpio2 RK_PC1 (GPIO_ACTIVE_LOW | GPIO_PULL_UP)>,
				 <&gpio2 RK_PC2 (GPIO_ACTIVE_LOW | GPIO_PULL_UP | GPIO_OPEN_DRAIN)>,
				 <&gpio2 RK_PB0 (GPIO_ACTIVE_LOW | GPIO_PULL_UP | GPIO_OPEN_DRAIN)>,
				 <&gpio2 RK_PB4 (GPIO_ACTIVE_LOW | GPIO_PULL_UP)>,
				 <&gpio1 RK_PD2 (GPIO_ACTIVE_LOW | GPIO_PULL_UP | GPIO_OPEN_DRAIN)>,
				 <&gpio1 RK_PD3 (GPIO_ACTIVE_LOW | GPIO_PULL_UP | GPIO_OPEN_DRAIN)>,
				 <&gpio4 RK_PC5 (GPIO_ACTIVE_LOW | GPIO_PULL_UP | GPIO_OPEN_DRAIN)>,
				 <&gpio2 RK_PB1 (GPIO_ACTIVE_LOW | GPIO_PULL_UP | GPIO_OPEN_DRAIN)>,
				 <&gpio1 RK_PD5 (GPIO_ACTIVE_LOW | GPIO_PULL_UP | GPIO_OPEN_DRAIN)>,
				 <&gpio1 RK_PC4 (GPIO_ACTIVE_LOW | GPIO_PULL_UP | GPIO_OPEN_DRAIN)>,
				 <&gpio4 RK_PD0 (GPIO_ACTIVE_LOW | GPIO_PULL_UP)>,
				 <&gpio1 RK_PD1 (GPIO_ACTIVE_LOW | GPIO_PULL_UP | GPIO_OPEN_DRAIN)>,
				 <&gpio4 RK_PD2 (GPIO_ACTIVE_LOW | GPIO_PULL_UP | GPIO_OPEN_DRAIN)>,
				 <&gpio4 RK_PD3 (GPIO_ACTIVE_LOW | GPIO_PULL_UP | GPIO_OPEN_DRAIN)>,
				 <&gpio1 RK_PB3 (GPIO_ACTIVE_LOW | GPIO_PULL_UP)>,
				 <&gpio4 RK_PB5 GPIO_ACTIVE_HIGH>,
				 <&gpio4 RK_PB6 GPIO_ACTIVE_HIGH>,
				 <&gpio4 RK_PD1 (GPIO_ACTIVE_LOW | GPIO_PULL_UP)>,
				 <&gpio4 RK_PC3 (GPIO_ACTIVE_LOW | GPIO_PULL_UP | GPIO_OPEN_DRAIN)>,
				 <&gpio2 RK_PC0 (GPIO_ACTIVE_LOW | GPIO_PULL_UP | GPIO_OPEN_DRAIN)>;

		pinctrl-names = "default";
		pinctrl-0 = <&seewoctl_iomux>;
	};
};
	/* ========== pinctrl ========== */
&pinctrl {
	seewo {
		seewoctl_iomux: seewoctl-iomux {
			rockchip,pins =
				<1 RK_PA0 RK_FUNC_GPIO &pcfg_pull_none>,
				<1 RK_PD0 RK_FUNC_GPIO &pcfg_pull_none>,
				<1 RK_PA4 RK_FUNC_GPIO &pcfg_pull_none>,
				<2 RK_PB5 RK_FUNC_GPIO &pcfg_pull_none>,
				<2 RK_PC4 RK_FUNC_GPIO &pcfg_pull_none>,
				<2 RK_PC1 RK_FUNC_GPIO &pcfg_pull_none>,
				<2 RK_PC2 RK_FUNC_GPIO &pcfg_pull_none>,
				<2 RK_PB0 RK_FUNC_GPIO &pcfg_pull_none>,
				<2 RK_PB4 RK_FUNC_GPIO &pcfg_pull_none>,
				<1 RK_PD2 RK_FUNC_GPIO &pcfg_pull_none>,
				<1 RK_PD3 RK_FUNC_GPIO &pcfg_pull_none>,
				<4 RK_PC5 RK_FUNC_GPIO &pcfg_pull_none>,
				<2 RK_PB1 RK_FUNC_GPIO &pcfg_pull_none>,
				<1 RK_PD5 RK_FUNC_GPIO &pcfg_pull_none>,
				<1 RK_PC4 RK_FUNC_GPIO &pcfg_pull_none>,
				<4 RK_PD0 RK_FUNC_GPIO &pcfg_pull_none>,
				<1 RK_PD1 RK_FUNC_GPIO &pcfg_pull_none>,
				<4 RK_PD2 RK_FUNC_GPIO &pcfg_pull_none>,
				<4 RK_PD3 RK_FUNC_GPIO &pcfg_pull_none>,
				<1 RK_PB3 RK_FUNC_GPIO &pcfg_pull_none>,
				<4 RK_PB5 RK_FUNC_GPIO &pcfg_pull_none>,
				<4 RK_PB6 RK_FUNC_GPIO &pcfg_pull_none>,
				<4 RK_PD1 RK_FUNC_GPIO &pcfg_pull_none>,
				<4 RK_PC3 RK_FUNC_GPIO &pcfg_pull_none>;
				<2 RK_PC0 RK_FUNC_GPIO &pcfg_pull_none>,
		};
	};
};